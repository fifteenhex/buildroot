## configs/mc68040_defconfig
```kconfig
BR2_m68k=y
BR2_TOOLCHAIN_BUILDROOT_MUSL=y
BR2_SYSTEM_DHCP="eth0"
BR2_PACKAGE_E2FSPROGS=y
BR2_PACKAGE_DOOM_WAD=y
BR2_PACKAGE_PRBOOM=y
BR2_PACKAGE_LIBXCRYPT=y
BR2_PACKAGE_DROPBEAR=y
BR2_PACKAGE_DROPBEAR_DISABLE_REVERSEDNS=y
BR2_PACKAGE_NTP=y
BR2_PACKAGE_NTP_SNTP=y
# BR2_PACKAGE_NTP_NTPD is not set
BR2_TARGET_ROOTFS_CPIO=y
BR2_TARGET_ROOTFS_CPIO_LZ4=y
BR2_TARGET_ROOTFS_EXT2=y
BR2_TARGET_ROOTFS_EXT2_SIZE="128m"
BR2_PACKAGE_EMILE=y
```

## configs/qemu_virt_mc68000_defconfig
```kconfig
BR2_m68k=y
BR2_m68k_68000=y
BR2_BINFMT_FLAT=y
BR2_BINFMT_FLAT_SEP_DATA=y
BR2_TOOLCHAIN_BUILDROOT_USE_SSP=y
# BR2_UCLIBC_INSTALL_UTILS is not set
BR2_BINUTILS_VERSION_2_41_X=y
BR2_GCC_VERSION_13_X=y
BR2_ENABLE_DEBUG=y
BR2_ENABLE_RUNTIME_DEBUG=y
BR2_ENABLE_LTO=y
BR2_PACKAGE_BUSYBOX_CONFIG="package/busybox/busybox-tiny.config"
BR2_PACKAGE_MTD=y
# BR2_PACKAGE_MTD_MTD_DEBUG is not set
# BR2_PACKAGE_MTD_NANDDUMP is not set
# BR2_PACKAGE_MTD_NANDTEST is not set
# BR2_PACKAGE_MTD_NANDWRITE is not set
# BR2_PACKAGE_MTD_MTDINFO is not set
# BR2_PACKAGE_MTD_UBIATTACH is not set
# BR2_PACKAGE_MTD_UBICRC32 is not set
# BR2_PACKAGE_MTD_UBIDETACH is not set
# BR2_PACKAGE_MTD_UBIFORMAT is not set
# BR2_PACKAGE_MTD_UBIHEALTHD is not set
# BR2_PACKAGE_MTD_UBIMKVOL is not set
# BR2_PACKAGE_MTD_UBINFO is not set
# BR2_PACKAGE_MTD_UBINIZE is not set
# BR2_PACKAGE_MTD_UBIRENAME is not set
# BR2_PACKAGE_MTD_UBIRMVOL is not set
# BR2_PACKAGE_MTD_UBIRSVOL is not set
# BR2_PACKAGE_MTD_UBIUPDATEVOL is not set
# BR2_PACKAGE_MTD_UBIBLOCK is not set
# BR2_PACKAGE_IFUPDOWN_SCRIPTS is not set
# BR2_PACKAGE_URANDOM_SCRIPTS is not set
BR2_TARGET_ROOTFS_SQUASHFS=y
BR2_TARGET_ROOTFS_SQUASHFS_BS_4K=y
BR2_TARGET_ROOTFS_SQUASHFS4_LZ4=y
BR2_PACKAGE_HOST_E2FSPROGS=y
```

## package/tftpd/Config.in.host
```kconfig
config BR2_PACKAGE_HOST_TFTPD
        bool "host tftpd"
        help
	  HPA's Trivial File Transfer Protocol (tftp) server.

	  https://git.kernel.org/pub/scm/network/tftp/tftp-hpa.git
```
